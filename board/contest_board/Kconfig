## nuttx/arch/arm/src/stm32n6/Kconfig
```kconfig
#
# STM32N6 Configuration Options
#

if ARCH_CHIP_STM32N6

comment "STM32N6 Configuration Options"

choice
	prompt "STM32N6 Chip Selection"
	default ARCH_CHIP_STM32N647
	depends on ARCH_CHIP_STM32N6

config ARCH_CHIP_STM32N647
	bool "STM32N647"
	---help---
		STM32N647 Cortex-M55 @ 600MHz, 512KB SRAM, 2MB Flash

endchoice

config STM32N6_HSE
	int "HSE Frequency (Hz)"
	default 24000000
	---help---
		Frequency of the external oscillator in Hz.

config STM32N6_HCLK
	int "HCLK Frequency (Hz)"
	default 600000000
	---help---
		Frequency of the AHB clock in Hz.

comment "UART Configuration"

config STM32N6_USART1
	bool "USART1 support"
	default y
	depends on ARCH_CHIP_STM32N6
	---help---
		Enable USART1 driver.

if STM32N6_USART1

config STM32N6_USART1_SERIAL_CONSOLE
	bool "USART1 console"
	default y
	depends on STM32N6_USART1
	---help---
		Use USART1 as the serial console.

config STM32N6_USART1_RXBUFSIZE
	int "USART1 RX buffer size"
	default 256
	depends on STM32N6_USART1

config STM32N6_USART1_TXBUFSIZE
	int "USART1 TX buffer size"
	default 256
	depends on STM32N6_USART1

config STM32N6_USART1_BAUD
	int "USART1 baud rate"
	default 115200
	depends on STM32N6_USART1

config STM32N6_USART1_BITS
	int "USART1 data bits"
	default 8
	depends on STM32N6_USART1

config STM32N6_USART1_PARITY
	int "USART1 parity (0=none, 1=odd, 2=even)"
	default 0
	depends on STM32N6_USART1

config STM32N6_USART1_STOPBITS
	int "USART1 stop bits"
	default 1
	depends on STM32N6_USART1

endif # STM32N6_USART1

config STM32N6_USART2
	bool "USART2 support"
	default n
	depends on ARCH_CHIP_STM32N6
	---help---
		Enable USART2 driver. USART2 is on APB1 (PCLK1).

if STM32N6_USART2

config STM32N6_USART2_SERIAL_CONSOLE
	bool "USART2 console"
	default n
	depends on STM32N6_USART2
	---help---
		Use USART2 as the serial console.

config STM32N6_USART2_RXBUFSIZE
	int "USART2 RX buffer size"
	default 256
	depends on STM32N6_USART2

config STM32N6_USART2_TXBUFSIZE
	int "USART2 TX buffer size"
	default 256
	depends on STM32N6_USART2

config STM32N6_USART2_BAUD
	int "USART2 baud rate"
	default 115200
	depends on STM32N6_USART2

config STM32N6_USART2_BITS
	int "USART2 data bits"
	default 8
	depends on STM32N6_USART2

config STM32N6_USART2_PARITY
	int "USART2 parity (0=none, 1=odd, 2=even)"
	default 0
	depends on STM32N6_USART2

config STM32N6_USART2_STOPBITS
	int "USART2 stop bits"
	default 1
	depends on STM32N6_USART2

endif # STM32N6_USART2

config STM32N6_USART3
	bool "USART3 support"
	default n
	depends on ARCH_CHIP_STM32N6
	---help---
		Enable USART3 driver. USART3 is on APB1 (PCLK1).

if STM32N6_USART3

config STM32N6_USART3_SERIAL_CONSOLE
	bool "USART3 console"
	default n
	depends on STM32N6_USART3
	---help---
		Use USART3 as the serial console.

config STM32N6_USART3_RXBUFSIZE
	int "USART3 RX buffer size"
	default 256
	depends on STM32N6_USART3

config STM32N6_USART3_TXBUFSIZE
	int "USART3 TX buffer size"
	default 256
	depends on STM32N6_USART3

config STM32N6_USART3_BAUD
	int "USART3 baud rate"
	default 115200
	depends on STM32N6_USART3

config STM32N6_USART3_BITS
	int "USART3 data bits"
	default 8
	depends on STM32N6_USART3

config STM32N6_USART3_PARITY
	int "USART3 parity (0=none, 1=odd, 2=even)"
	default 0
	depends on STM32N6_USART3

config STM32N6_USART3_STOPBITS
	int "USART3 stop bits"
	default 1
	depends on STM32N6_USART3

endif # STM32N6_USART3

comment "GPIO Configuration"

config STM32N6_GPIO
	bool "GPIO support"
	default y
	depends on ARCH_CHIP_STM32N6
	---help---
		Enable GPIO driver support for STM32N6.

if STM32N6_GPIO

config STM32N6_GPIO_IRQ
	bool "GPIO interrupt support"
	default y
	depends on STM32N6_GPIO
	---help---
		Enable GPIO interrupt (EXTI) support.

config STM32N6_GPIOA
	bool "GPIO Port A"
	default y
	depends on STM32N6_GPIO
	---help---
		Enable GPIO Port A.

config STM32N6_GPIOB
	bool "GPIO Port B"
	default y
	depends on STM32N6_GPIO
	---help---
		Enable GPIO Port B.

config STM32N6_GPIOC
	bool "GPIO Port C"
	default y
	depends on STM32N6_GPIO
	---help---
		Enable GPIO Port C.

config STM32N6_GPIOD
	bool "GPIO Port D"
	default n
	depends on STM32N6_GPIO
	---help---
		Enable GPIO Port D.

config STM32N6_GPIOE
	bool "GPIO Port E"
	default n
	depends on STM32N6_GPIO
	---help---
		Enable GPIO Port E.

config STM32N6_GPIOF
	bool "GPIO Port F"
	default n
	depends on STM32N6_GPIO
	---help---
		Enable GPIO Port F.

config STM32N6_GPIOG
	bool "GPIO Port G"
	default n
	depends on STM32N6_GPIO
	---help---
		Enable GPIO Port G.

config STM32N6_GPIOH
	bool "GPIO Port H"
	default n
	depends on STM32N6_GPIO
	---help---
		Enable GPIO Port H.

endif # STM32N6_GPIO

comment "I2C Configuration"

config STM32N6_I2C1
	bool "I2C1 support"
	default n
	depends on ARCH_CHIP_STM32N6
	select I2C_DRIVER
	---help---
		Enable I2C1 driver. I2C1 uses PB6 (SCL) and PB7 (SDA) by default.

config STM32N6_I2C2
	bool "I2C2 support"
	default n
	depends on ARCH_CHIP_STM32N6
	select I2C_DRIVER
	---help---
		Enable I2C2 driver. I2C2 uses PB10 (SCL) and PB11 (SDA) by default.

config STM32N6_I2C3
	bool "I2C3 support"
	default n
	depends on ARCH_CHIP_STM32N6
	select I2C_DRIVER
	---help---
		Enable I2C3 driver. I2C3 uses PA7 (SCL) and PB5 (SDA) by default.

config STM32N6_I2C4
	bool "I2C4 support (via I3C1)"
	default n
	depends on ARCH_CHIP_STM32N6
	select I2C_DRIVER
	---help---
		Enable I2C4 driver using I3C1 hardware in I2C-compatible mode.
		Note: STM32N647 has I3C1 at this address, not a dedicated I2C4.

comment "SPI Configuration"

config STM32N6_SPI1
	bool "SPI1 support"
	default n
	depends on ARCH_CHIP_STM32N6
	---help---
		Enable SPI1 driver.

config STM32N6_SPI2
	bool "SPI2 support"
	default n
	depends on ARCH_CHIP_STM32N6
	---help---
		Enable SPI2 driver.

config STM32N6_SPI3
	bool "SPI3 support"
	default n
	depends on ARCH_CHIP_STM32N6
	---help---
		Enable SPI3 driver.

config STM32N6_SPI_DMA
	bool "SPI DMA support"
	default n
	depends on (STM32N6_SPI1 || STM32N6_SPI2 || STM32N6_SPI3)
	---help---
		Enable DMA support for SPI transfers.

config STM32N6_SPI_INTERRUPTS
	bool "SPI interrupt support"
	default n
	depends on (STM32N6_SPI1 || STM32N6_SPI2 || STM32N6_SPI3)
	---help---
		Enable interrupt-driven SPI transfers.
		Note: Currently not implemented, use polling mode.

comment "XSPI Configuration"

config STM32N6_XSPI2
	bool "XSPI2 support (Octal SPI for NOR Flash)"
	default n
	depends on ARCH_CHIP_STM32N6
	select MTD
	select MTD_MX25RXX
	---help---
		Enable XSPI2 driver for Octal SPI NOR Flash (MX25UM25645G).
		XSPI2 is connected to external NOR Flash on STM32N647-EVB.

if STM32N6_XSPI2

config STM32N6_XSPI2_FREQUENCY
	int "XSPI2 clock frequency (Hz)"
	default 50000000
	depends on STM32N6_XSPI2
	---help---
		XSPI2 interface clock frequency in Hz.

config STM32N6_XSPI2_FLASH_SIZE
	int "XSPI2 Flash size (bytes)"
	default 33554432
	depends on STM32N6_XSPI2
	---help---
		Size of the external NOR Flash connected to XSPI2.
		Default is 32MB (MX25UM25645G).

endif # STM32N6_XSPI2

comment "LCD/LTDC Configuration"

config STM32N6_LTDC
	bool "LTDC support"
	default n
	depends on ARCH_CHIP_STM32N6
	select LCD
	select LCD_FRAMEBUFFER
	---help---
		Enable LTDC (LCD-TFT Display Controller) driver.
		For STM32N6570-DK with DSI LCD display.

if STM32N6_LTDC

config STM32N6_LTDC_WIDTH
	int "LCD width (pixels)"
	default 800
	depends on STM32N6_LTDC
	---help---
		LCD display width in pixels.

config STM32N6_LTDC_HEIGHT
	int "LCD height (pixels)"
	default 480
	depends on STM32N6_LTDC
	---help---
		LCD display height in pixels.

endif # STM32N6_LTDC

comment "DCMIPP Camera Configuration"

config STM32N6_DCMIPP
	bool "DCMIPP camera interface"
	default n
	depends on ARCH_CHIP_STM32N6
	select I2C_DRIVER
	---help---
		Enable DCMIPP (Digital Camera Interface Pixel Pipeline) driver.
		Supports parallel (DCMI) and CSI camera interfaces.

if STM32N6_DCMIPP

config STM32N6_DCMIPP_IMX335
	bool "IMX335 sensor support"
	default n
	depends on STM32N6_DCMIPP
	---help---
		Enable Sony IMX335 5MP sensor support via CSI interface.
		Requires I2C and CSI PHY configuration.

config STM32N6_DCMIPP_OV5640
	bool "OV5640 sensor support"
	default n
	depends on STM32N6_DCMIPP
	---help---
		Enable OmniVision OV5640 5MP sensor support via parallel
		interface. Requires I2C (SCCB) configuration.

endif # STM32N6_DCMIPP

endif # ARCH_CHIP_STM32N6
```

## nuttx/drivers/ai/Kconfig
```kconfig
#
# drivers/ai/Kconfig
#

menuconfig AI
	bool "AI/TinyML Support"
	default n
	---help---
		Enable AI and TinyML support for embedded machine learning
		inference on Cortex-M processors with CMSIS-NN acceleration.

if AI

config AI_TINYML
	bool "TinyML Inference Engine"
	default y
	---help---
		Enable the TinyML inference engine for running quantized
		neural network models on microcontrollers.

config AI_CMSIS_NN
	bool "CMSIS-NN Backend"
	default y
	---help---
		Use ARM CMSIS-NN as the backend for neural network operations.
		This provides optimized implementations for Cortex-M processors.

config AI_CMSIS_NN_HELUM
	bool "Enable Helium (MVE) Acceleration"
	default y if ARCH_CHIP_STM32N6
	depends on AI_CMSIS_NN
	---help---
		Enable ARM Helium M-Profile Vector Extension (MVE) acceleration
		for CMSIS-NN operations. This provides up to 4x speedup on
		Cortex-M55 processors.

config AI_IMG_CLASSIFIER
	bool "Image Classification Example"
	default y
	depends on AI_TINYML
	depends on VIDEO_V4L2
	---help---
		Enable the image classification example that uses the camera
		to capture images and classify them using a TinyML model.

config AI_MODEL_ARENA_SIZE
	int "Model Arena Size (bytes)"
	default 65536
	---help---
		Maximum memory arena size for model inference. This determines
		the maximum model size that can be loaded.

config AI_INPUT_WIDTH
	int "Input Image Width"
	default 96
	depends on AI_IMG_CLASSIFIER
	---help---
		Width of the input image for classification.

config AI_INPUT_HEIGHT
	int "Input Image Height"
	default 96
	depends on AI_IMG_CLASSIFIER
	---help---
		Height of the input image for classification.

config AI_INPUT_CHANNELS
	int "Input Image Channels"
	default 3
	depends on AI_IMG_CLASSIFIER
	---help---
		Number of channels in the input image (3 for RGB).

config AI_NUM_CLASSES
	int "Number of Classification Classes"
	default 10
	depends on AI_IMG_CLASSIFIER
	---help---
		Number of output classes for the classification model.

config AI_AGENT
	bool "AI Agent Bridge"
	default y
	depends on AI_TINYML
	---help---
		Enable the AI Agent bridge that connects TinyML inference
		with camera, printer, and LCD display peripherals. This
		allows the AI Agent to coordinate TinyML "cerebellum" with
		cloud LLM "brain".

endif # AI
```

## nuttx/examples/ai_demo/Kconfig
```kconfig
#
# examples/ai_demo/Kconfig
#

config EXAMPLES_AI_DEMO
	bool "AI Demo Application"
	default y
	depends on AI
	depends on AI_TINYML
	depends on AI_AGENT
	---help---
		Enable the AI Demo application that demonstrates TinyML
		image classification with AI Agent integration.

		The demo shows the "cerebellum + brain" architecture:
		- TinyML (Cortex-M55 + Helium MVE) for local inference
		- AI Agent (Cloud LLM) for coordination and user interaction
		- Camera capture, LCD display, thermal printer output

		Usage: ai_demo [-h] [-c] [-s] [-t] [-a]
		  -h  Show help
		  -c  Run continuous classification
		  -s  Run single classification (default)
		  -t  Test TinyML inference engine
		  -a  Test AI Agent tools
```
