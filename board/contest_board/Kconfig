## board/contest_board/configs/nsh/defconfig
```kconfig
CONFIG_ARCH="arm"
CONFIG_ARCH_BOARD="stm32n647-evb"
CONFIG_ARCH_BOARD_STM32N647_EVB=y
CONFIG_ARCH_CHIP="stm32n6"
CONFIG_ARCH_CHIP_STM32N647=y
CONFIG_ARCH_CHIP_STM32N6=y
CONFIG_ARCH_INTERRUPTSTACK=2048
CONFIG_BOARD_LOOPSPERMSEC=1000
CONFIG_BUILTIN=y
CONFIG_DEBUG_ASSERTIONS=y
CONFIG_DEBUG_FEATURES=y
CONFIG_DEBUG_SYMBOLS=y
CONFIG_STACK_USAGE_WARNING=0
CONFIG_DEFAULT_TASK_STACKSIZE=4096
CONFIG_EXAMPLES_HELLO=y
CONFIG_FLASH_SIZE=2097152
CONFIG_FLASH_START=0x08000000
CONFIG_FS_FAT=y
CONFIG_FS_LITTLEFS=n
CONFIG_FS_PROCFS=y
CONFIG_IDLETHREAD_STACKSIZE=4096
CONFIG_INIT_ENTRYPOINT="nsh_main"
CONFIG_INTELHEX_BINARY=y
CONFIG_MATH_GEMMLOWP=n
CONFIG_MATH_KISSFFT=n
CONFIG_MATH_RUY=n
CONFIG_MTD=y
CONFIG_NSH_ARCHINIT=y
CONFIG_NSH_BUILTIN_APPS=y
CONFIG_NSH_FILEIOSIZE=512
CONFIG_NSH_READLINE=y
CONFIG_PREALLOC_TIMERS=4
CONFIG_RAM_SIZE=524288
CONFIG_RAM_START=0x20000000
CONFIG_RAW_BINARY=y
CONFIG_RR_INTERVAL=200
CONFIG_SCHED_HPWORK=y
CONFIG_SCHED_HPWORKPRIORITY=192
CONFIG_STACK_COLORATION=y
CONFIG_START_DAY=26
CONFIG_START_MONTH=8
CONFIG_START_YEAR=2026
CONFIG_SYSTEM_FLATBUFFERS=n
CONFIG_SYSTEM_NSH=y
CONFIG_USEC_PER_TICK=1000
# CONFIG_EXAMPLES_GPIO is not set
CONFIG_ARCH_ARMV8M=y
CONFIG_ARCH_CORTEXM55=y
CONFIG_ARCH_TOOLCHAIN_GNU=y
CONFIG_ARCH_TOOLCHAIN_GNU_EABI=y
CONFIG_ARM_TOOLCHAIN_GNU_EABI=y
CONFIG_ARCH_ARM_M=y
CONFIG_BUILD_FLAT=y
CONFIG_BUILTIN_TOOLCHAIN=y
CONFIG_ARCH_HAVE_DEBUG=y
CONFIG_ARCH_CPUINFO_FREQ_KHZ=600000
CONFIG_PERCPU_ARRAY=y
CONFIG_UP=y
CONFIG_ARCH_HAVE_IRQTRIGGER=y
CONFIG_NCPUS=1
CONFIG_NFILE_DESCRIPTORS=16
CONFIG_NFILE_STREAMS=8
CONFIG_NFILE_DESCRIPTORS_PER_BLOCK=8
CONFIG_STREAM_OUT_BUFFER_SIZE=64
CONFIG_STREAM_HEXDUMP_BUFFER_SIZE=32
CONFIG_STREAM_BASE64_BUFFER_SIZE=34
CONFIG_LIBC_REGEX=y
CONFIG_LIBC_EXECFUNCS=y
CONFIG_LIBC_MAX_EXITFUNS=4
CONFIG_LIBC_MAX_TMPFILE=32
CONFIG_LIBC_HOMEDIR="/home"
CONFIG_LIBC_FTOK_VFS_PATH="/tmp"
CONFIG_LIBC_ATOMIC_TOOLCHAIN=y
CONFIG_LIBC_LOCALE=y
CONFIG_LIBC_TZDIR="/etc/zoneinfo"
CONFIG_LIBC_TZ_MAX_TIMES=370
CONFIG_LIBC_TZ_MAX_TYPES=20
CONFIG_SCHED_HPWORKSTACKSIZE=2048
CONFIG_SCHED_HPWORKSTACKSECTION=""
CONFIG_SCHED_HPWORKTHREADIDLESTACKSECTION=""
CONFIG_SCHED_STACK_RECORD=0
CONFIG_SCHED_PROFILE_TICKSPERSEC=100
CONFIG_SCHED_CPULOAD_TIMECONSTANT=2
CONFIG_MM_DEFAULT_ALIGNMENT=8
CONFIG_MM_NODE_GUARDSIZE=0
CONFIG_MM_SMALL=y
CONFIG_MM_REGIONS=1
CONFIG_MM_DEFAULT_MANAGER=y
CONFIG_MAX_TASKS=16
CONFIG_MAX_TASK_ARGS=8
CONFIG_PID_INITIAL_COUNT=32
CONFIG_PREALLOC_MQ_MSGS=8
CONFIG_PREALLOC_MQ_IRQ_MSGS=4
CONFIG_MQ_MAXMSGSIZE=64
CONFIG_INIT_STACKSIZE=2048
CONFIG_INIT_ENTRYNAME="nsh_main"
CONFIG_TASK_NAME_SIZE=16
CONFIG_LINE_MAX=64
CONFIG_POSIX_SPAWN_DEFAULT_STACKSIZE=2048
CONFIG_POSIX_TIMERS_MAX=8
CONFIG_SIG_ALLOC_ACTIONS=4
CONFIG_SIG_DEFAULT_STACKSIZE=2048
CONFIG_SIG_PREALLOC_IRQ_ACTIONS=4
CONFIG_PTHREAD_STACK_DEFAULT=2048
CONFIG_PTHREAD_GUARDSIZE_DEFAULT=0
CONFIG_PTHREAD_STACK_MIN=256
CONFIG_TLS_NCLEANUP=2
CONFIG_FS_NEPOLL_DESCRIPTORS=8
CONFIG_FS_LOCK_BUCKET_SIZE=8
CONFIG_FS_MQUEUE_VFS_PATH="/var/mqueue"
CONFIG_FS_AIO_LISTIO_MAX=4
CONFIG_NAME_MAX=32
CONFIG_PATH_MAX=256
CONFIG_IRQ_WORK_STACKSIZE=2048
CONFIG_IRQ_NWORKS=1
CONFIG_IRQ_WORK_SECTION=""
CONFIG_FTL_USLEEP=100
CONFIG_BINFMT_DISABLE=n
CONFIG_COREDUMP=y
CONFIG_CXX_EXCEPTION=n
CONFIG_CXX_RTTI=n
CONFIG_HAVE_CXX=n
CONFIG_LIBCXXTOOLCHAIN=n
CONFIG_SERIAL=y
CONFIG_STANDARD_SERIAL=y
CONFIG_UART0_SERIAL_CONSOLE=y
CONFIG_STM32N6_USART1=y
CONFIG_STM32N6_USART1_RXBUFSIZE=256
CONFIG_STM32N6_USART1_TXBUFSIZE=256
CONFIG_STM32N6_USART1_BAUD=115200
CONFIG_STM32N6_USART1_BITS=8
CONFIG_STM32N6_USART1_PARITY=0
CONFIG_STM32N6_USART1_2STOP=0
CONFIG_DEV_GPIO=y
CONFIG_DEV_GPIO_NPOLLWAITERS=2
CONFIG_DEV_OPTEE_NONE=y
CONFIG_SYSTEM_NSH_CPLUSPLUS=n
CONFIG_SYSTEM_NSH_PRIORITY=100
CONFIG_SYSTEM_NSH_STACKSIZE=2048
CONFIG_SYSTEM_NSH_PROGNAME="nsh"
CONFIG_NSH_LIBRARY=y
CONFIG_NSH_CONSOLE=y
CONFIG_NSH_MAXARGUMENTS=16
CONFIG_NSH_PROC_MOUNTPOINT="/proc"
CONFIG_NSH_PROMPT_MAX=32
CONFIG_NSH_PROMPT_STRING="nsh> "
CONFIG_NSH_PROMPT_SUFFIX=" "
CONFIG_NSH_PROMPT_ENV="PS1"
CONFIG_NSH_DISABLE_CAT=n
CONFIG_NSH_DISABLE_CD=n
CONFIG_NSH_DISABLE_CP=n
CONFIG_NSH_DISABLE_CMP=n
CONFIG_NSH_DISABLE_DD=n
CONFIG_NSH_DISABLE_DIRNAME=n
CONFIG_NSH_DISABLE_ECHO=n
CONFIG_NSH_DISABLE_ENV=n
CONFIG_NSH_DISABLE_EXEC=n
CONFIG_NSH_DISABLE_EXIT=n
CONFIG_NSH_DISABLE_EXPORT=n
CONFIG_NSH_DISABLE_HELP=n
CONFIG_NSH_DISABLE_HEXDUMP=n
CONFIG_NSH_DISABLE_LS=n
CONFIG_NSH_DISABLE_MB=n
CONFIG_NSH_DISABLE_MKDIR=n
CONFIG_NSH_DISABLE_MKFIFO=n
CONFIG_NSH_DISABLE_MOUNT=n
CONFIG_NSH_DISABLE_MV=n
CONFIG_NSH_DISABLE_PRINTF=n
CONFIG_NSH_DISABLE_PS=n
CONFIG_NSH_DISABLE_PWD=n
CONFIG_NSH_DISABLE_RM=n
CONFIG_NSH_DISABLE_RMDIR=n
CONFIG_NSH_DISABLE_SET=n
CONFIG_NSH_DISABLE_SLEEP=n
CONFIG_NSH_DISABLE_SOURCE=n
CONFIG_NSH_DISABLE_TEST=n
CONFIG_NSH_DISABLE_TIME=n
CONFIG_NSH_DISABLE_UNSET=n
CONFIG_NSH_DISABLE_UNAME=n
CONFIG_NSH_DISABLE_USLEEP=n
CONFIG_NSH_DISABLE_WHICH=n
CONFIG_NSH_ARGCAT=y
CONFIG_EXAMPLES_HELLO_PROGNAME="hello"
CONFIG_EXAMPLES_HELLO_PRIORITY=100
CONFIG_EXAMPLES_HELLO_STACKSIZE=2048
CONFIG_EXAMPLES_AI_DEMO=y
CONFIG_SYSTEM_READLINE=y
CONFIG_SYSTEM_READLINE_STACKSIZE=2048
CONFIG_SYSTEM_READLINE_PRIORITY=100
CONFIG_SYSLOG=y
CONFIG_SYSLOG_INTBUFFER=y
CONFIG_SYSLOG_MAX_CHANNELS=1
CONFIG_SYSLOG_DEFAULT_MASK=0xff
CONFIG_STACK_USAGE_WARNING=0
CONFIG_BASE_DEFCONFIG=""
CONFIG_SYSLOG_CHAR_CONSOLE=y
CONFIG_SYSLOG_RATELIMIT_INTERVAL=0
CONFIG_SYSLOG_RATELIMIT_BURST=0
CONFIG_SPI=y
CONFIG_SPI_EXCHANGE=y
CONFIG_STM32N6_SPI1=y
CONFIG_THERMAL_PRINTER=y

# XSPI2 NOR Flash support
CONFIG_STM32N6_XSPI2=y
CONFIG_STM32N6_XSPI2_FREQUENCY=50000000
CONFIG_STM32N6_XSPI2_FLASH_SIZE=33554432
CONFIG_MTD_MX25UM25645G=y

# DCMIPP Camera support
CONFIG_I2C_DRIVER=y
CONFIG_STM32N6_I2C1=y
CONFIG_DRIVERS_VIDEO=y
CONFIG_VIDEO_STREAM=y
CONFIG_VIDEO_REQBUFS_COUNT_MAX=4
CONFIG_STM32N6_DCMIPP=y
CONFIG_STM32N6_DCMIPP_IMX335=y
CONFIG_STM32N6_DCMIPP_OV5640=y
CONFIG_DEBUG_VIDEO_ERROR=y
CONFIG_DEBUG_VIDEO_WARN=y
CONFIG_DEBUG_VIDEO_INFO=y

# AI/TinyML support
CONFIG_AI=y
CONFIG_AI_TINYML=y
CONFIG_AI_CMSIS_NN=y
CONFIG_AI_CMSIS_NN_HELUM=y
CONFIG_AI_IMG_CLASSIFIER=y
CONFIG_AI_AGENT=y
CONFIG_AI_MODEL_ARENA_SIZE=65536
CONFIG_AI_INPUT_WIDTH=96
CONFIG_AI_INPUT_HEIGHT=96
CONFIG_AI_INPUT_CHANNELS=3
CONFIG_AI_NUM_CLASSES=10
```

## board/contest_board/src/stm32n6/Kconfig
```kconfig
#
# STM32N6 Configuration Options
#

if ARCH_CHIP_STM32N6

comment "STM32N6 Configuration Options"

choice
	prompt "STM32N6 Chip Selection"
	default ARCH_CHIP_STM32N647
	depends on ARCH_CHIP_STM32N6

config ARCH_CHIP_STM32N647
	bool "STM32N647"
	---help---
		STM32N647 Cortex-M55 @ 600MHz, 512KB SRAM, 2MB Flash

endchoice

config STM32N6_HSE
	int "HSE Frequency (Hz)"
	default 24000000
	---help---
		Frequency of the external oscillator in Hz.

config STM32N6_HCLK
	int "HCLK Frequency (Hz)"
	default 600000000
	---help---
		Frequency of the AHB clock in Hz.

comment "UART Configuration"

config STM32N6_USART1
	bool "USART1 support"
	default y
	depends on ARCH_CHIP_STM32N6
	---help---
		Enable USART1 driver.

if STM32N6_USART1

config STM32N6_USART1_SERIAL_CONSOLE
	bool "USART1 console"
	default y
	depends on STM32N6_USART1
	---help---
		Use USART1 as the serial console.

config STM32N6_USART1_RXBUFSIZE
	int "USART1 RX buffer size"
	default 256
	depends on STM32N6_USART1

config STM32N6_USART1_TXBUFSIZE
	int "USART1 TX buffer size"
	default 256
	depends on STM32N6_USART1

config STM32N6_USART1_BAUD
	int "USART1 baud rate"
	default 115200
	depends on STM32N6_USART1

config STM32N6_USART1_BITS
	int "USART1 data bits"
	default 8
	depends on STM32N6_USART1

config STM32N6_USART1_PARITY
	int "USART1 parity (0=none, 1=odd, 2=even)"
	default 0
	depends on STM32N6_USART1

config STM32N6_USART1_STOPBITS
	int "USART1 stop bits"
	default 1
	depends on STM32N6_USART1

endif # STM32N6_USART1

comment "GPIO Configuration"

config STM32N6_GPIO
	bool "GPIO support"
	default y
	depends on ARCH_CHIP_STM32N6
	---help---
		Enable GPIO driver support for STM32N6.

if STM32N6_GPIO

config STM32N6_GPIO_IRQ
	bool "GPIO interrupt support"
	default y
	depends on STM32N6_GPIO
	---help---
		Enable GPIO interrupt (EXTI) support.

config STM32N6_GPIOA
	bool "GPIO Port A"
	default y
	depends on STM32N6_GPIO
	---help---
		Enable GPIO Port A.

config STM32N6_GPIOB
	bool "GPIO Port B"
	default y
	depends on STM32N6_GPIO
	---help---
		Enable GPIO Port B.

config STM32N6_GPIOC
	bool "GPIO Port C"
	default y
	depends on STM32N6_GPIO
	---help---
		Enable GPIO Port C.

config STM32N6_GPIOD
	bool "GPIO Port D"
	default n
	depends on STM32N6_GPIO
	---help---
		Enable GPIO Port D.

config STM32N6_GPIOE
	bool "GPIO Port E"
	default n
	depends on STM32N6_GPIO
	---help---
		Enable GPIO Port E.

config STM32N6_GPIOF
	bool "GPIO Port F"
	default n
	depends on STM32N6_GPIO
	---help---
		Enable GPIO Port F.

config STM32N6_GPIOG
	bool "GPIO Port G"
	default n
	depends on STM32N6_GPIO
	---help---
		Enable GPIO Port G.

config STM32N6_GPIOH
	bool "GPIO Port H"
	default n
	depends on STM32N6_GPIO
	---help---
		Enable GPIO Port H.

endif # STM32N6_GPIO

comment "I2C Configuration"

config STM32N6_I2C1
	bool "I2C1 support"
	default n
	depends on ARCH_CHIP_STM32N6
	select I2C_DRIVER
	---help---
		Enable I2C1 driver. I2C1 uses PB6 (SCL) and PB7 (SDA) by default.

config STM32N6_I2C2
	bool "I2C2 support"
	default n
	depends on ARCH_CHIP_STM32N6
	select I2C_DRIVER
	---help---
		Enable I2C2 driver. I2C2 uses PB10 (SCL) and PB11 (SDA) by default.

config STM32N6_I2C3
	bool "I2C3 support"
	default n
	depends on ARCH_CHIP_STM32N6
	select I2C_DRIVER
	---help---
		Enable I2C3 driver. I2C3 uses PA7 (SCL) and PB5 (SDA) by default.

config STM32N6_I2C4
	bool "I2C4 support (via I3C1)"
	default n
	depends on ARCH_CHIP_STM32N6
	select I2C_DRIVER
	---help---
		Enable I2C4 driver using I3C1 hardware in I2C-compatible mode.
		Note: STM32N647 has I3C1 at this address, not a dedicated I2C4.

comment "SPI Configuration"

config STM32N6_SPI1
	bool "SPI1 support"
	default n
	depends on ARCH_CHIP_STM32N6
	---help---
		Enable SPI1 driver.

config STM32N6_SPI2
	bool "SPI2 support"
	default n
	depends on ARCH_CHIP_STM32N6
	---help---
		Enable SPI2 driver.

config STM32N6_SPI3
	bool "SPI3 support"
	default n
	depends on ARCH_CHIP_STM32N6
	---help---
		Enable SPI3 driver.

config STM32N6_SPI_DMA
	bool "SPI DMA support"
	default n
	depends on (STM32N6_SPI1 || STM32N6_SPI2 || STM32N6_SPI3)
	---help---
		Enable DMA support for SPI transfers.

config STM32N6_SPI_INTERRUPTS
	bool "SPI interrupt support"
	default n
	depends on (STM32N6_SPI1 || STM32N6_SPI2 || STM32N6_SPI3)
	---help---
		Enable interrupt-driven SPI transfers.
		Note: Currently not implemented, use polling mode.

comment "LCD/LTDC Configuration"

config STM32N6_LTDC
	bool "LTDC support"
	default n
	depends on ARCH_CHIP_STM32N6
	select LCD
	select LCD_FRAMEBUFFER
	select STM32N6_GPIOA
	select STM32N6_GPIOB
	select STM32N6_GPIOF
	select STM32N6_GPIOG
	select STM32N6_GPIOH
	---help---
		Enable LTDC (LCD-TFT Display Controller) driver.
		For STM32N647-EVB with 800x480 RGB LCD panel.

if STM32N6_LTDC

config STM32N6_LTDC_WIDTH
	int "LCD width (pixels)"
	default 800
	depends on STM32N6_LTDC
	---help---
		LCD display width in pixels.

config STM32N6_LTDC_HEIGHT
	int "LCD height (pixels)"
	default 480
	depends on STM32N6_LTDC
	---help---
		LCD display height in pixels.

endif # STM32N6_LTDC

endif # ARCH_CHIP_STM32N6
```
